## meta-e27/conf/layer.conf
```bitbake
# We have a conf and classes directory, add to BBPATH
BBPATH .= ":${LAYERDIR}"

# We have recipes-* directories, add to BBFILES
BBFILES += "${LAYERDIR}/recipes-*/*/*.bb \
	${LAYERDIR}/recipes-*/*/*.bbappend"

BBFILE_COLLECTIONS += "e27"
BBFILE_PATTERN_e27 = "^${LAYERDIR}/"
BBFILE_PRIORITY_e27 = "7"
```
